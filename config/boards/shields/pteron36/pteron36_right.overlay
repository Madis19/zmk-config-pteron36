#include "pteron36.dtsi"

&default_transform {
    col-offset = <5>;
};

&kscan0 {
    col-gpios= <&pro_micro  A1 (GPIO_ACTIVE_HIGH )>
		       <&pro_micro  A0 (GPIO_ACTIVE_HIGH )>,
			   <&pro_micro  15 (GPIO_ACTIVE_HIGH )>,
			   <&pro_micro  14 (GPIO_ACTIVE_HIGH )>,
			   <&pro_micro  16 (GPIO_ACTIVE_HIGH )>;
    };